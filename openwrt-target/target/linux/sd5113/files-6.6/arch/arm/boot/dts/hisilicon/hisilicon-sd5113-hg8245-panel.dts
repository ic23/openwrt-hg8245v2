// SPDX-License-Identifier: GPL-2.0-only
#include "hisilicon-sd5113-hg8245-fxs.dts"
#include "hisilicon-sd5113-hg8245-gpio-map.dtsi"
#include "hisilicon-sd5113-hg8245-leds.dtsi"

&switch0 {
	huawei,front-panel-leds;
};
