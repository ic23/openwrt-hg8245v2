// SPDX-License-Identifier: GPL-2.0-only

#define DIRECT_GPIO(n) n 0 &gpio0 n 0

/ {
	stock_gpio: stock-gpio-map {
		#gpio-cells = <2>;
		gpio-map-mask = <0xffffffff 0>;
		gpio-map-pass-thru = <0 0xffffffff>;
		gpio-map = <
			DIRECT_GPIO(0)  DIRECT_GPIO(1)  DIRECT_GPIO(2)  DIRECT_GPIO(3)
			DIRECT_GPIO(4)  DIRECT_GPIO(5)  DIRECT_GPIO(6)  DIRECT_GPIO(7)
			DIRECT_GPIO(8)  DIRECT_GPIO(9)  DIRECT_GPIO(10) DIRECT_GPIO(11)
			DIRECT_GPIO(12) DIRECT_GPIO(13) DIRECT_GPIO(14) DIRECT_GPIO(15)
			DIRECT_GPIO(16) DIRECT_GPIO(17) DIRECT_GPIO(18) DIRECT_GPIO(19)
			DIRECT_GPIO(20) DIRECT_GPIO(21) DIRECT_GPIO(22) DIRECT_GPIO(23)
			DIRECT_GPIO(24) DIRECT_GPIO(25) DIRECT_GPIO(26) DIRECT_GPIO(27)
			DIRECT_GPIO(28) DIRECT_GPIO(29) DIRECT_GPIO(30) DIRECT_GPIO(31)
			DIRECT_GPIO(32) DIRECT_GPIO(33) DIRECT_GPIO(34) DIRECT_GPIO(35)
			DIRECT_GPIO(36) DIRECT_GPIO(37) DIRECT_GPIO(38) DIRECT_GPIO(39)
			DIRECT_GPIO(40) DIRECT_GPIO(41) DIRECT_GPIO(42) DIRECT_GPIO(43)
			DIRECT_GPIO(44) 45 0 &gpio0 43 0 DIRECT_GPIO(46) DIRECT_GPIO(47)
			DIRECT_GPIO(48) DIRECT_GPIO(49) DIRECT_GPIO(50) DIRECT_GPIO(51)
			DIRECT_GPIO(52) DIRECT_GPIO(53) DIRECT_GPIO(54) DIRECT_GPIO(55)
			DIRECT_GPIO(56) DIRECT_GPIO(57) DIRECT_GPIO(58) DIRECT_GPIO(59)
			DIRECT_GPIO(60) DIRECT_GPIO(61) DIRECT_GPIO(62) DIRECT_GPIO(63)
		>;
	};
};

#undef DIRECT_GPIO

&gpio0 {
	hisilicon,debug-gpio-banks;
};
