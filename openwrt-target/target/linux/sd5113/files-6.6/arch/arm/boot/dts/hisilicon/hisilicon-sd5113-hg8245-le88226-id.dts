// SPDX-License-Identifier: GPL-2.0-only
#include "hisilicon-sd5113-hg8245-spi.dts"

&spi0 {
	codec@0 {
		compatible = "huawei,hg8245-le88226-id";
		reg = <0>;
		spi-max-frequency = <8000000>;
		spi-cpol;
		spi-cpha;
	};
};
