// SPDX-License-Identifier: GPL-2.0-only
#include "hisilicon-sd5113-hg8245-voice-chain.dts"
#include "hisilicon-sd5113-hg8245-gpio-map.dtsi"
#include "hisilicon-sd5113-hg8245-keys.dtsi"
#include "hisilicon-sd5113-hg8245-leds.dtsi"
#include "hisilicon-sd5113-hg8245-i2c.dtsi"

/ {
	huawei,board-io-lab;
};
