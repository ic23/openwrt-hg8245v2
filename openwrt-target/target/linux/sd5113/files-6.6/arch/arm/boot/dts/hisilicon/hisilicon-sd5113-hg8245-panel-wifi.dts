// SPDX-License-Identifier: GPL-2.0-only
#include "hisilicon-sd5113-hg8245-panel.dts"
#include <dt-bindings/input/input.h>

/ {
	gpio-keys {
		compatible = "gpio-keys-polled";
		poll-interval = <20>;

		button-wps {
			label = "wps";
			linux,code = <KEY_WPS_BUTTON>;
			gpios = <&stock_gpio 12 GPIO_ACTIVE_LOW>;
			debounce-interval = <60>;
		};
	};
};
